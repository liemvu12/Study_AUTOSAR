AUTOSAR XML
os OS
  general General
  applicationmodelist ApplicationModeList
    applicationmode OSDEFAULTAPPMODE
  applicationlist ApplicationList
    application OsDefaultApp
  tasklist TaskList
    task SchM_Startup
      applicationmodelist ApplicationModeList
        applicationmode OSDEFAULTAPPMODE
    task SchM_BswService
      eventlist EventList
        event EventForLwip
  alarmlist AlarmList
    alarm Alarm_BswService
  counterlist CounterList
    counter OsClock
  resourcelist ResourceList
    resource RES_SCHEDULER
  internalresourcelist InternalResourceList
ecuc EcuC
  pdulist PduList
    33 x pdu:
      TxDiagP2P
      RxDiagP2P
      TxDiagP2A
      RxDiagP2A
      TxMsgTime
      RxMsgAbsInfo
      LS_NM_TX
      OSEK_NM_TX
      OSEK_NM_RX
      XCP_RX
      XCP_TX
      SOAD_RX
      SOAD_TX
      STDIN
      STDOUT
      RX_J1939TP_REVERSE_CM
      RX_J1939TP_DT
      RX_J1939TP_CM
      RX_J1939TP_DIRECT
      TX_J1939TP_CmNPdu
      TX_J1939TP_DtNPdu
      TX_J1939TP_FcNPdu
      TX_J1939TP_DirectNPdu
      J1939TP_RX
      J1939TP_TX
      RxMsgFD
      TxMsgFD
      LIN_RX_MSG1
      LIN_TX_MSG1
      RxCan2LinDiag
      TxCan2LinDiag
      RxLinDiag
      TxLinDiag
can Can
  general General
  controllerlist ControllerList
    controller CAN_CTRL_0
      hohlist HohList
        hoh Can0Hrh
        hoh Can0Hth
canif CanIf
  general General
  channellist ChannelList
    channel CANIF_CHL_LS
      hthlist HthList
        hth LS_Hth
      txpdulist TxPduList
        13 x pdu:
          P2P
          P2A
          LS_NM
          Time
          OSEK_NM_TX
          XCP_TX
          STDOUT
          TX_J1939TP_CmNPdu
          TX_J1939TP_DtNPdu
          TX_J1939TP_FcNPdu
          TX_J1939TP_DirectNPdu
          TxMsgFD
          TxCan2LinDiag
      hrhlist HrhList
        hrh LS_Hrh
      rxpdulist RxPduList
        12 x pdu:
          P2P
          P2A
          AbsInfo
          OSEK_NM_RX
          XCP_RX
          STDIN
          RX_J1939TP_REVERSE_CM
          RX_J1939TP_DT
          RX_J1939TP_CM
          RX_J1939TP_DIRECT
          RxMsgCanFD
          RxCan2LinDiag
cantp CanTp
  general General
  rxsdulist RxSduList
    sdu SduP2P
    sdu SduP2A
    sdu RxCan2LinDiag
  txsdulist TxSduList
    sdu SduP2P
    sdu SduP2A
    sdu TxCan2LinDiag
pdur PduR
  general General
  routinelist RoutineList
    18 x source:
      DcmP2P
        destinationlist DestinationList
          destination CanTpP2P
      CanTpP2P
        destinationlist DestinationList
          destination DcmP2P
      DcmP2A
        destinationlist DestinationList
          destination CanTpP2A
      CanTpP2A
        destinationlist DestinationList
          destination DcmP2A
      TxCan2LinDiag
        destinationlist DestinationList
          destination TxCan2LinDiag
      RxCan2LinDiag
        destinationlist DestinationList
          destination RxCan2LinDiag
      TxLinDiag
        destinationlist DestinationList
          destination TxLinDiag
      RxLinDiag
        destinationlist DestinationList
          destination RxLinDiag
      ComMsgTime
        destinationlist DestinationList
          destination CanIfMsgTime
      CanIfMsgAbs
        destinationlist DestinationList
          destination ComMsgAbs
      SOAD_RX
        destinationlist DestinationList
          destination DCM_SOAD_RX
      SOAD_TX
        destinationlist DestinationList
          destination DCM_SOAD_TX
      DcmTxOnJ1939
        destinationlist DestinationList
          destination DcmTxOnJ1939
      DcmRxOnJ1939
        destinationlist DestinationList
          destination Destination1
      RxMsgFD
        destinationlist DestinationList
          destination Destination1
      TxMsgFD
        destinationlist DestinationList
          destination Destination1
      LIN_RX_MSG1
        destinationlist DestinationList
          destination Destination1
      LIN_TX_MSG1
        destinationlist DestinationList
          destination Destination1
com Com
  general General
  pdugrouplist PduGroupList
    pdugroup PduGroup1
  ipdulist IPduList
    6 x ipdu:
      MsgTime
        groupsignallist GroupSignalList
          groupsignal SystemTime
            signallist SignalList
              6 x signal:
                year
                month
                day
                hour
                minute
                second
      AbsInfo
        signallist SignalList
          5 x signal:
            VehicleSpeed
            TachoSpeed
            Led{1..3}Sts
      RxMsgFD
        signallist SignalList
          4 x signal:
            RxMsgFD_Signal{1..4}
      TxMsgFD
        signallist SignalList
          4 x signal:
            TxMsgFD_Signal{1..4}
      LIN_TX_MSG1
        signallist SignalList
          signal LIN_TX_MSG1_DATA
      LIN_RX_MSG1
        signallist SignalList
          signal LIN_RX_MSG1_DATA
dcm Dcm
  general General
  bufferlist BufferList
    8 x buffer:
      Buffer{1..8}
  sessionlist SessionList
    session DS
    session PRGS
    session EXTDS
  securitylist SecurityList
    security PRGS
    security EXTDS
    security DS
  didcontrolrecordlist DIDControlRecordList
  didinfolist DIDInfoList
  didlist DIDList
  routineinfolist RoutineInfoList
  routinelist RoutineList
  memorylist MemoryList
  protocollist ProtocolList
    4 x protocol:
      P2P
        connectionlist ConnectionList
          connection Connection1
            rxchannellist RxChannelList
              rxchannel RxChannel1
            txchannel TxChannel2
      P2A
        connectionlist ConnectionList
          connection Connection1
            rxchannellist RxChannelList
              rxchannel RxChannel1
            txchannel TxChannel2
      DoIP
        connectionlist ConnectionList
          connection Connection1
            rxchannellist RxChannelList
              rxchannel RxChannel1
            txchannel TxChannel2
      J1939
        connectionlist ConnectionList
          connection Connection1
            rxchannellist RxChannelList
              rxchannel RxChannel1
            txchannel TBD
  requestservicelist RequestServiceList
    requestservice RequestService1
  servicetablelist ServiceTableList
    servicetable ServiceTableP2P
      servicelist ServiceList
        7 x service:
          DIAGNOSTIC_SESSION_CONTROL
            securitylist SecurityList
              security DS
              security PRGS
              security EXTDS
            sessionlist SessionList
              session DS
              session PRGS
              session EXTDS
          SECURITY_ACCESS
            securitylist SecurityList
              security DS
              security PRGS
              security EXTDS
            sessionlist SessionList
              session EXTDS
          TESTER_PRESENT
            securitylist SecurityList
              security DS
              security PRGS
              security EXTDS
            sessionlist SessionList
              session EXTDS
          ECU_RESET
            securitylist SecurityList
              security EXTDS
            sessionlist SessionList
              session EXTDS
          READ_DATA_BY_IDENTIFIER
            securitylist SecurityList
              security EXTDS
              security PRGS
            sessionlist SessionList
              session EXTDS
              session PRGS
          READ_DTC_INFORMATION
            securitylist SecurityList
              security EXTDS
            sessionlist SessionList
              session EXTDS
          CLEAR_DIAGNOSTIC_INFORMATION
            securitylist SecurityList
              security EXTDS
            sessionlist SessionList
              session EXTDS
    servicetable ServiceTableP2A
      servicelist ServiceList
        service DIAGNOSTIC_SESSION_CONTROL
          securitylist SecurityList
            security EXTDS
            security DS
          sessionlist SessionList
            session EXTDS
            session DS
        service TESTER_PRESENT
          securitylist SecurityList
            security EXTDS
            security DS
          sessionlist SessionList
            session DS
            session EXTDS
  sessioncontrollist SessionControlList
    sessioncontrol SessionControl1
  timinglist TimingList
    timing Timing1
fls Fls
  general General
  sectorlist SectorList
    sector NVM
fee Fee
  general General
  blocklist BlockList
    5 x block:
      Time
      Config
      Finger_Print
      DemHealing
      Dem_DemFreezeFrame
ea Ea
  general General
  blocklist BlockList
    block EaTest1
    block EaTest2
nvm NvM
  general General
  blocklist BlockList
    7 x block:
      Time
        datalist DataList
          6 x data:
            Year
            Month
            Day
            Hour
            Minute
            Second
      FingerPrint
        datalist DataList
          data bytes
      Config
        datalist DataList
          data bytes
      EaTest1
        datalist DataList
          4 x data:
            Data{0..3}
      EaTest2
        datalist DataList
          4 x data:
            Data{1..4}
      DemHealing
        datalist DataList
          struct HealingRec
            datalist DataList
              data eventId
              data agingCounter
              data checksum
      DemFreezeFrame
        datalist DataList
          struct FreezeFrameRec
            datalist DataList
              8 x data:
                eventId
                kind
                occurrence
                dataSize
                recordNumber
                timeStamp
                data
                checksum
xcp Xcp
  general General
  xcpstaticdaqlist XcpStaticDaqList
    xcpdaq XcpDaq1
      xcpodtlist XcpOdtList
        xcpodt XcpOdt1
          xcpodtentrylist XcpOdtEntryList
            xcpentry XcpEntry{1..3}
        xcpodt XcpOdt2
          xcpodtentrylist XcpOdtEntryList
            xcpentry XcpEntry{1..3}
  xcpeventchannellist XcpEventChannelList
    xcpeventchannel 1000ms
      xcpstaticdaqlist XcpStaticDaqList
        xcpdaq XcpDaq1
rte Rte
  datatypelist DataTypeList
    datatype InactiveActive_T
    datatype OnOff_T
  constantlist ConstantList
    constant C_TELLTALE_OFF_IV
  swclist SwcList
    swc Telltale
      portlist PortList
        port TelltaleTPMSStatus
        port TelltaleAutoCruiseStatus
        port TelltaleHighBeamStatus
dem Dem
  general General
  extendeddatarecordclasslist ExtendedDataRecordClassList
    extendeddatarecordclass ExtendedDataRecordClass_Odometer
  dtcclasslist DTCClassList
    dtcclass DTCAirbag
  ffidclasslist FFIdClassList
    ffidclass AirbagFFIdClass
  freezeframeclasslist FreezeFrameClassList
    freezeframeclass AirbagFreezeFrameClass
      ffidclassreflist FFIdClassRefList
        ffidclassref AirbagFFIdClass
  eventclasslist EventClassList
    eventclass BSWEventClass
    eventclass SWCEventClass
  eventparameterlist EventParameterList
    12 x eventparameter:
      EEP_E_WRITE_FAILED
      EEP_E_READ_FAILED
      FLS_E_ERASE_FAILED
      FLS_E_WRITE_FAILED
      FLS_E_READ_FAILED
      CANNM_E_NETWORK_TIMEOUT
      PDUR_E_PDU_INSTANCE_LOST
      NVM_E_INTEGRITY_FAILED
      NVM_E_REQ_FAILED
      ECUM_E_ALL_RUN_REQUESTS_KILLED
      ECUM_E_RAM_CHECK_FAILED
      AIRBAG_FAILED
        freezeframeclassreflist FreezeFrameClassRefList
          freezeframeclassref AirbagFreezeFrameClass
        extendeddataclassreflist ExtendedDataClassRefList
          extendeddataclassref ExtendedDataRecordClass_Odometer
j1939tp J1939Tp
  general General
  channellist ChannelList
    channel J1939TP_RX_CHL
    channel J1939TP_TX_CHL
  parametergrouplist ParameterGroupList
    parametergroup PG_RX
    parametergroup PG_TX
  pduinfolist PduInfoList
    8 x pduinfo:
      RX_J1939TP_REVERSE_CM
      RX_J1939TP_CM
      RX_J1939TP_DT
      RX_J1939TP_DIRECT
      TX_J1939TP_CmNPdu
      TX_J1939TP_DtNPdu
      TX_J1939TP_FcNPdu
      TX_J1939TP_DirectNPdu
